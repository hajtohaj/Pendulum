/*
 * Copyright (C) 2013 CircuitCo
 *
 * Virtual cape for UART1 on connector pins P9.24 P9.26
 *
 * This program is free software; you can redistribute it and/or modify
 * it under the terms of the GNU General Public License version 2 as
 * published by the Free Software Foundation.
 */
/dts-v1/;
/plugin/;

/ {
   	compatible = "ti,beaglebone-black";

        /* identification */
        part-number = "BBB-CAN-0";
        version = "00A0";

        /* state the resources this cape uses */
        exclusive-use =
                /* the pin header uses */
                "P9.19",        /* dcan0_rx */
                "P9.20",        /* dcan0_tx */
                /* the hardware ip uses */
                "dcan0";

        fragment@0 {
                target = <&am33xx_pinmux>;
                __overlay__ {
                        bb_dcan0_pins: pinmux_bb_dcan0_pins {
                                pinctrl-single,pins = <
                                        0x17C 0x32 /* P9.19 dcan0_rx INPUT | PULL UP | MODE_2 */
                                        0x178 0x02 /* P9.20 dcan0_tx OUTPUT | PULL UP | MODE_2 */
                                >;
                        };
                };
        };

	fragment@1 {
                target = <&dcan0>;	/* ??? */
                __overlay__ {
                        status = "okay";
                        pinctrl-names = "default";
                        pinctrl-0 = <&bb_dcan0_pins>;
                };
        };
};
