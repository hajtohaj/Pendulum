/*
 * Copyright (C) 2013 CircuitCo
 *
 * Virtual cape for UART1 on connector pins P9.24 P9.26
 *
 * This program is free software; you can redistribute it and/or modify
 * it under the terms of the GNU General Public License version 2 as
 * published by the Free Software Foundation.
 */
/dts-v1/;
/plugin/;

/ {
   	compatible = "ti,beaglebone-black";

        /* identification */
        part-number = "BBB-CAN-1";
        version = "00A0";

        /* state the resources this cape uses */
        exclusive-use =
                /* the pin header uses */
                "P9.24",        /* dcan1_rx */
                "P9.26",        /* dcan1_tx */
                /* the hardware ip uses */
                "dcan1";

        fragment@0 {
                target = <&am33xx_pinmux>;
                __overlay__ {
                        bb_dcan1_pins: pinmux_bb_dcan1_pins {
                                pinctrl-single,pins = <
                                        0x184 0x32 /* P9.24 dcan0_rx INPUT | PULL UP | MODE_2 */
                                        0x180 0x02 /* P9.26 dcan0_tx OUTPUT | MODE_2 */
                                >;
                        };
                };
        };

	fragment@1 {
                target = <&dcan1>;	/* ??? */
                __overlay__ {
                        status = "okay";
                        pinctrl-names = "default";
                        pinctrl-0 = <&bb_dcan1_pins>;
                };
        };
};
